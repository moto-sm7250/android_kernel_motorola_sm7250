## drivers/input/touchscreen/himax_0flash_mmi/Kconfig
```kconfig
#
# Himax Touchscreen driver configuration
#

config TOUCHSCREEN_HIMAX_SPI
	tristate "HIMAX chipset SPI touchscreen"
	depends on TOUCHSCREEN_HIMAX_CHIPSET
	help
	  This enables support for HIMAX CHIPSET over SPI based touchscreens.

config TOUCHSCREEN_HIMAX_INCELL
	tristate "HIMAX chipset in-cell function"
	depends on TOUCHSCREEN_HIMAX_SPI
	help
	  This enables support for HIMAX CHIPSET of in-cell function.

config TOUCHSCREEN_HIMAX_IC_HX83112
	tristate "HIMAX chipset HX83112 function"
	depends on TOUCHSCREEN_HIMAX_INCELL
	help
	  This enables support for HIMAX CHIPSET of HX83112.

config TOUCHSCREEN_HIMAX_IC_HX83112F
	tristate "HIMAX chipset HX83112F function"
	depends on TOUCHSCREEN_HIMAX_INCELL
	help
	  This enables support for HIMAX CHIPSET of HX83112F.

config TOUCHSCREEN_HIMAX_IC_HX83102
	tristate "HIMAX chipset HX83102 function"
	depends on TOUCHSCREEN_HIMAX_INCELL
	help
	  This enables support for HIMAX CHIPSET of HX83102.

config TOUCHSCREEN_HIMAX_IC_HX83102D
	tristate "HIMAX chipset HX83102D function"
	depends on TOUCHSCREEN_HIMAX_INCELL
	help
	  This enables support for HIMAX CHIPSET of HX83102D.

config TOUCHSCREEN_HIMAX_DEBUG
	tristate "HIMAX debug function"
	depends on TOUCHSCREEN_HIMAX_SPI
	help
	  This enables support for HIMAX debug function.

config TOUCHSCREEN_HIMAX_INSPECT
	tristate "HIMAX inspect function"
	depends on TOUCHSCREEN_HIMAX_SPI
	help
	  This enables support for HIMAX debug function.

config HMX_DB
	tristate "HIMAX driver test over Dragon Board"
	depends on TOUCHSCREEN_HIMAX_SPI
	help
	  This enables support for HIMAX driver test over Dragon Board.

config TOUCHSCREEN_HIMAX_ENABLE_PALM
	tristate "HIMAX inspect function"
	depends on TOUCHSCREEN_HIMAX_SPI
	help
	  This enables support for HIMAX palm function.

config TOUCHSCREEN_HIMAX_ENABLE_DOUBLE_TAP
	tristate "HIMAX inspect function"
	depends on TOUCHSCREEN_HIMAX_SPI
	help
	  This enables support for HIMAX double tap function.

config TOUCHSCREEN_HIMAX_ENABLE_MULTI_BIN
	tristate "HIMAX inspect function"
	depends on TOUCHSCREEN_HIMAX_SPI
	help
	  This enables support for HIMAX multi bin function.

config TOUCHSCREEN_HIMAX_PANEL_NOTIFICATIONS
	tristate "HIMAX inspect function"
	depends on TOUCHSCREEN_HIMAX_SPI
	help
	  This enables support for HIMAX notification function.
```

## drivers/power/Kconfig
```kconfig
source "drivers/power/avs/Kconfig"
source "drivers/power/reset/Kconfig"
source "drivers/power/supply/Kconfig"
source "drivers/power/bq27426_fg_mmi/Kconfig"
source "drivers/power/qpnp_adaptive_charge/Kconfig"
source "drivers/power/qpnp-smbcharger-mmi/Kconfig"
```

## drivers/power/bq27426_fg_mmi/Kconfig
```kconfig
config BQ27426_FG_MMI
        tristate "BQ27426 FG"
        default n
        help
         Say Y here if you have a bq27426 fg compatible
         device connected.

         This driver can also be built as a module.  If so, the module
         will be called bq27426_fg_mmi.

config ATL_4000MAH_8A_BATTERY_PROFILE
        bool "ATL 4000MAH 8A BATTERY PROFILE"
        depends on BQ27426_FG_MMI
        default n
        help
         Say Y here if your chip uses the ATL 4000MAH 8A BATTERY PROFILE

config SCUD_4000MAH_8A_BATTERY_PROFILE
        bool "SCUD 4000MAH 8A BATTERY PROFILE"
        depends on BQ27426_FG_MMI
        default n
        help
         Say Y here if your chip uses the SCUD 4000MAH 8A BATTERY PROFILE

config ATL_LS40_1545MAH_BATTERY_PROFILE
        bool "ATL LS40 1545MAH BATTERY PROFILE"
        depends on BQ27426_FG_MMI
        default n
        help
         Say Y here if your chip uses the ATL LS40 1545MAH BATTERY PROFILE

config ATL_LS30_1255MAH_BATTERY_PROFILE
        bool "ATL LS30 1255MAH BATTERY PROFILE"
        depends on BQ27426_FG_MMI
        default n
        help
         Say Y here if your chip uses the ATL LS30 1255MAH BATTERY PROFILE
```
